## examples/mcu/esp-idf-eth/sdkconfig.defaults
```kconfig
CONFIG_COMPILER_CXX_EXCEPTIONS=n
CONFIG_COMPILER_CXX_RTTI=n

# lwIP dialed down for one TCP connection on the constrained target. The TCP window and
# send buffer track the single-connection telemetry shape; IPv6 is a later milestone.
CONFIG_LWIP_TCP_WND_DEFAULT=5760
CONFIG_LWIP_TCP_SND_BUF_DEFAULT=5760
CONFIG_LWIP_MAX_SOCKETS=4
CONFIG_LWIP_IPV6=n

# Internal RMII EMAC for a LAN8720/IP101-class PHY (RMII clock + MDC/MDIO defaults).
CONFIG_ETH_USE_ESP32_EMAC=y
CONFIG_ETH_PHY_INTERFACE_RMII=y
CONFIG_ETH_RMII_CLK_INPUT=y
```

## examples/mcu/esp-idf-liveliness-bench/sdkconfig.defaults
```kconfig
CONFIG_COMPILER_CXX_EXCEPTIONS=n
CONFIG_COMPILER_CXX_RTTI=n

# Console stays on UART0 (the flash/console port); the liveliness telemetry rides UART2
# on GPIO17/GPIO16 to the second USB-serial adapter.
CONFIG_ESP_CONSOLE_UART_DEFAULT=y
```

## examples/mcu/esp-idf-lwip-bench/sdkconfig.defaults
```kconfig
CONFIG_COMPILER_CXX_EXCEPTIONS=n
CONFIG_COMPILER_CXX_RTTI=n

# lwIP dialed down for one TCP connection on the constrained target — the SAME small window as the
# Wi-Fi example. The bench measures this MCU-appropriate config; the window is NOT raised for
# throughput (a tuned-up window would inflate the numbers).
CONFIG_LWIP_TCP_WND_DEFAULT=5760
CONFIG_LWIP_TCP_SND_BUF_DEFAULT=5760
CONFIG_LWIP_MAX_SOCKETS=4
CONFIG_LWIP_IPV6=n

# The console stays on UART0 so the bench emits its machine-parseable sample lines there; the
# serial cell's plexus link rides UART1 instead, so the two never share a port.
CONFIG_ESP_CONSOLE_UART_DEFAULT=y

# The RX task is looked up by name (xTaskGetHandle) to read its stack high-water — that lookup needs
# the trace facility. The runtime-stats clock stays off; only the name registry is required.
CONFIG_FREERTOS_USE_TRACE_FACILITY=y
```

## examples/mcu/esp-idf-lwip-discovery/sdkconfig.defaults
```kconfig
CONFIG_COMPILER_CXX_EXCEPTIONS=n
CONFIG_COMPILER_CXX_RTTI=n

# lwIP dialed down for the constrained target. IGMP multicast membership is on (the discovery leaf
# joins 239.255.0.7); IPv6 is a later milestone.
CONFIG_LWIP_MAX_SOCKETS=4
CONFIG_LWIP_IPV6=n
```

## examples/mcu/esp-idf-lwip/sdkconfig.defaults
```kconfig
CONFIG_COMPILER_CXX_EXCEPTIONS=n
CONFIG_COMPILER_CXX_RTTI=n

# lwIP dialed down for one TCP connection on the constrained target. The TCP window and
# send buffer track the single-connection telemetry shape; IPv6 is a later milestone.
CONFIG_LWIP_TCP_WND_DEFAULT=5760
CONFIG_LWIP_TCP_SND_BUF_DEFAULT=5760
CONFIG_LWIP_MAX_SOCKETS=4
CONFIG_LWIP_IPV6=n
```

## examples/mcu/esp-idf-onboard-bench/sdkconfig.defaults
```kconfig
# Match the component's -fno-exceptions -fno-rtti override: the substrate
# is exception-free and RTTI-free on the constrained target.
CONFIG_COMPILER_CXX_EXCEPTIONS=n
CONFIG_COMPILER_CXX_RTTI=n

# The console stays on the default UART0: this onboard bench owns no link, so it emits its
# machine-parseable BENCH sample/witness/resource lines there with std::printf. Nothing rides a
# wire here — the console is the only output.
CONFIG_ESP_CONSOLE_UART_DEFAULT=y
```

## examples/mcu/esp-idf-onboard/sdkconfig.defaults
```kconfig
# Match the component's -fno-exceptions -fno-rtti override: the substrate
# is exception-free and RTTI-free on the constrained target.
CONFIG_COMPILER_CXX_EXCEPTIONS=n
CONFIG_COMPILER_CXX_RTTI=n

# The console stays on the default UART0: this onboard example owns no link, so it logs
# each self-delivered value with ESP_LOGI. Nothing rides a wire here — the console is the
# only output.
```

## examples/mcu/esp-idf-topic-graph/sdkconfig.defaults
```kconfig
# Match the component's -fno-exceptions -fno-rtti override: the substrate
# is exception-free and RTTI-free on the constrained target.
CONFIG_COMPILER_CXX_EXCEPTIONS=n
CONFIG_COMPILER_CXX_RTTI=n

# plexus owns UART0 — silence the IDF runtime console/log on the data link so framed
# bytes are not interleaved with console output. The bounded magic-byte resync in the
# framing layer tolerates the un-suppressable boot-ROM preamble (the host resyncs past it).
CONFIG_ESP_CONSOLE_NONE=y
```

## examples/mcu/esp-idf/sdkconfig.defaults
```kconfig
# Match the LOCKED component override (-fno-exceptions -fno-rtti): the substrate
# is exception-free and RTTI-free on the constrained target.
CONFIG_COMPILER_CXX_EXCEPTIONS=n
CONFIG_COMPILER_CXX_RTTI=n
```
